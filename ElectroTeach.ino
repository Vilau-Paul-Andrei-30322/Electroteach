// Images to display on OLED
#include <Wire.h>
#include <LiquidCrystal_I2C.h>
#include <Adafruit_GFX.h>
#include <Adafruit_SSD1306.h>

// LCD and OLED display setup
LiquidCrystal_I2C lcd(0x27, 16, 2);  // LCD address for 16 chars and 2 line display
#define SCREEN_WIDTH 128
#define SCREEN_HEIGHT 32
Adafruit_SSD1306 display(SCREEN_WIDTH, SCREEN_HEIGHT, &Wire, -1);


   static const unsigned char PROGMEM logo[] = {
    0xff, 0xff, 0xff, 0xff, 0xff, 0xff, 0xff, 0xff, 0xff, 0xff, 0xff, 0xff, 0xff, 0xff, 0xff, 0xff, 
    0xff, 0xff, 0xff, 0xff, 0xff, 0xff, 0xff, 0x81, 0xff, 0xff, 0xff, 0xff, 0xff, 0xff, 0xff, 0xff, 
    0xff, 0xff, 0xff, 0xff, 0xff, 0xff, 0xf8, 0x00, 0x1f, 0xff, 0xff, 0xff, 0xff, 0xff, 0xff, 0xff, 
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    0xff, 0xff, 0xff, 0xff, 0xff, 0xff, 0xff, 0xff, 0xff, 0xff, 0xff, 0xff, 0xff, 0xff, 0xff, 0xff
   };
static const unsigned char PROGMEM image1_easy[] = {
0xff, 0xff, 0xff, 0xff, 0xff, 0xff, 0xff, 0xff, 0xff, 0xff, 0xff, 0xff, 0xff, 0xff, 0xff, 0xff, 
    0xff, 0xff, 0xff, 0xe0, 0x00, 0x00, 0x00, 0x00, 0x00, 0x00, 0x00, 0x00, 0x1f, 0xff, 0xff, 0xff, 
    0xff, 0xff, 0xff, 0xcf, 0xff, 0xff, 0xff, 0xff, 0xff, 0xc3, 0xff, 0xff, 0xcf, 0xff, 0xff, 0xff, 
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    0xff, 0xff, 0xff, 0xff, 0xff, 0xff, 0xff, 0xff, 0xff, 0xff, 0xff, 0xff, 0xff, 0xff, 0xff, 0xff  
    
};
static const unsigned char PROGMEM image2_easy[] = {
0xff, 0xff, 0xff, 0xff, 0xff, 0xff, 0xff, 0xff, 0xff, 0xff, 0xff, 0xff, 0xff, 0xff, 0xff, 0xff, 
0xff, 0xff, 0xff, 0xff, 0xfc, 0x3f, 0xff, 0xff, 0xff, 0xff, 0xff, 0xff, 0xff, 0xff, 0xff, 0xff, 
0xff, 0xff, 0xff, 0xff, 0xe0, 0x3f, 0xff, 0xff, 0xf7, 0x7b, 0xff, 0xff, 0xff, 0xff, 0xff, 0xff, 
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0xff, 0xff, 0xff, 0xff, 0xff, 0xff, 0xff, 0xff, 0xff, 0xff, 0xff, 0xff, 0xff, 0xff, 0xff, 0xff
};
static const unsigned char PROGMEM image3_easy[] = {
    0xff, 0xff, 0xff, 0xff, 0xff, 0xff, 0xff, 0xff, 0xff, 0xe3, 0xff, 0xff, 0xff, 0xff, 0xff, 0xff, 
    0xff, 0xff, 0xff, 0xff, 0xff, 0xff, 0xff, 0xff, 0xff, 0xe1, 0xff, 0xff, 0xff, 0xff, 0xff, 0xff, 
    0xff, 0xff, 0xff, 0xff, 0xff, 0xff, 0xff, 0xff, 0xff, 0xe3, 0xff, 0xff, 0xff, 0xff, 0xff, 0xff, 
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    0xff, 0xff, 0xff, 0xff, 0xff, 0xff, 0xff, 0xff, 0xff, 0xff, 0xff, 0xff, 0xff, 0xff, 0xff, 0xff
};
static const unsigned char PROGMEM image1_medium[] = {
  0xff, 0xff, 0xff, 0xff, 0xff, 0xff, 0xff, 0xff, 0xff, 0xff, 0xff, 0xff, 0xff, 0xff, 0xff, 0xff, 
    0xff, 0xff, 0xff, 0xff, 0xff, 0xff, 0xff, 0xff, 0xff, 0xff, 0xff, 0xff, 0xff, 0xff, 0xff, 0xff, 
    0xff, 0xff, 0xff, 0xff, 0x9d, 0xef, 0xff, 0xff, 0xce, 0x37, 0xff, 0xff, 0xff, 0xff, 0xff, 0xff, 
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    0xff, 0xfc, 0x00, 0x00, 0x00, 0x00, 0x00, 0x00, 0x00, 0x00, 0x00, 0x00, 0x00, 0x00, 0x03, 0xff
    };
static const unsigned char PROGMEM image2_medium[] = {
  0xff, 0xff, 0xff, 0xff, 0xff, 0xff, 0xff, 0xff, 0xff, 0xff, 0xff, 0xff, 0xff, 0xff, 0xff, 0xff, 
    0xff, 0xff, 0xff, 0xff, 0xff, 0xff, 0xff, 0xff, 0xff, 0xff, 0xff, 0xff, 0xff, 0xff, 0xff, 0xff, 
    0xff, 0xff, 0xff, 0xff, 0x9d, 0xef, 0xff, 0xff, 0xce, 0x37, 0xff, 0xff, 0xff, 0xff, 0xff, 0xff, 
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    0xff, 0xfc, 0x00, 0x00, 0x00, 0x00, 0x00, 0x00, 0x00, 0x00, 0x00, 0x00, 0x00, 0x00, 0x03, 0xff
    };
    static const unsigned char PROGMEM image3_medium[] = {
  0xff, 0xff, 0xff, 0xff, 0xff, 0xff, 0xff, 0xff, 0xff, 0xff, 0xff, 0xff, 0xff, 0xff, 0xff, 0xff, 
    0xff, 0xff, 0xff, 0xff, 0xff, 0xff, 0xff, 0xff, 0xff, 0xff, 0xff, 0xff, 0xff, 0xff, 0xff, 0xff, 
    0xff, 0xff, 0xff, 0xff, 0xff, 0xff, 0xff, 0xff, 0xff, 0xff, 0xff, 0xff, 0xff, 0xff, 0xff, 0xff, 
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    0xff, 0xff, 0xff, 0xff, 0xff, 0xff, 0xff, 0xff, 0xff, 0xff, 0xff, 0xff, 0xff, 0xff, 0xff, 0xff
};
static const unsigned char PROGMEM image1_hard[] = {
  0xff, 0xff, 0xff, 0xff, 0xff, 0xff, 0xff, 0xff, 0xff, 0xff, 0xff, 0xff, 0xff, 0xff, 0xff, 0xff, 
    0xff, 0xff, 0xff, 0xff, 0xff, 0xff, 0xff, 0xff, 0xff, 0xff, 0xff, 0xff, 0xff, 0xff, 0xff, 0xff, 
    0xff, 0xff, 0xff, 0xff, 0xff, 0xff, 0xff, 0xff, 0xff, 0xff, 0xff, 0xff, 0xff, 0xff, 0xff, 0xff, 
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    0xff, 0xff, 0xff, 0xff, 0xff, 0xff, 0xff, 0xff, 0xff, 0xff, 0xff, 0xff, 0xff, 0xff, 0xff, 0xff
};
static const unsigned char PROGMEM image2_hard[] = {
   0xff, 0xff, 0xff, 0xff, 0xff, 0xff, 0xff, 0xff, 0xff, 0xff, 0xff, 0xff, 0xff, 0xff, 0xff, 0xff, 
    0xff, 0xff, 0xff, 0xff, 0xff, 0xff, 0xff, 0xff, 0xff, 0xff, 0xff, 0xff, 0xff, 0xff, 0xff, 0xff, 
    0xff, 0xff, 0xff, 0xff, 0xff, 0xff, 0xff, 0xff, 0xff, 0xff, 0xff, 0xff, 0xff, 0xff, 0xff, 0xff, 
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    0xff, 0xff, 0xff, 0xff, 0xff, 0xff, 0xff, 0xff, 0xff, 0xff, 0xff, 0xff, 0xff, 0xff, 0xff, 0xff
};
static const unsigned char PROGMEM image3_hard[] = {
  0xff, 0xff, 0xff, 0xff, 0xff, 0xff, 0xff, 0xff, 0xff, 0xff, 0xff, 0xff, 0xff, 0xff, 0xff, 0xff, 
    0xff, 0xff, 0xff, 0xff, 0xff, 0xff, 0xfe, 0x4d, 0xff, 0xff, 0xff, 0xff, 0xff, 0xff, 0xff, 0xff, 
    0xff, 0xff, 0xff, 0xff, 0xff, 0xff, 0xfe, 0x44, 0xff, 0xff, 0xff, 0xff, 0xff, 0xff, 0xff, 0xff, 
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    0xff, 0xff, 0xff, 0xff, 0xff, 0xff, 0xff, 0xff, 0xff, 0xff, 0xff, 0xff, 0xff, 0xff, 0xff, 0xff
};
    
static const unsigned char PROGMEM outputimage1_easy[] = {
  0xff, 0xff, 0xff, 0xff, 0xff, 0xff, 0xff, 0xff, 0xff, 0xff, 0xff, 0xff, 0xff, 0xff, 0xff, 0xff, 
    0xff, 0xdf, 0xff, 0xff, 0x83, 0xff, 0xff, 0xe3, 0xff, 0xff, 0xc1, 0xff, 0xff, 0xf9, 0xff, 0xff, 
    0xff, 0x07, 0xff, 0xff, 0x91, 0xff, 0xff, 0xc3, 0xff, 0xff, 0xc8, 0xff, 0xff, 0xf0, 0xff, 0xff, 
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    0xff, 0xff, 0xff, 0xff, 0xff, 0xff, 0xff, 0xff, 0xff, 0xff, 0xff, 0xff, 0xff, 0xff, 0xff, 0xff
};

static const unsigned char PROGMEM outputimage1_medium[] = {
  0xff, 0xff, 0xff, 0xff, 0xff, 0xff, 0xff, 0xff, 0xff, 0xff, 0xff, 0xff, 0xff, 0xff, 0xff, 0xff, 
    0xff, 0xff, 0xff, 0xff, 0xff, 0xff, 0xfe, 0x4d, 0xff, 0xff, 0xff, 0xff, 0xff, 0xff, 0xff, 0xff, 
    0xff, 0xff, 0xff, 0xff, 0xff, 0xff, 0xfe, 0x44, 0xff, 0xff, 0xff, 0xff, 0xff, 0xff, 0xff, 0xff, 
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    0xff, 0xff, 0xff, 0xff, 0xff, 0xff, 0xff, 0xff, 0xff, 0xff, 0xff, 0xff, 0xff, 0xff, 0xff, 0xff
};

static const unsigned char PROGMEM outputimage1_hard[] = {
  0xff, 0xff, 0xff, 0xff, 0xff, 0xff, 0xff, 0xff, 0xff, 0xff, 0xff, 0xff, 0xff, 0xff, 0xff, 0xff, 
    0xff, 0xdf, 0xff, 0xff, 0x83, 0xff, 0xff, 0xe3, 0xff, 0xff, 0xc1, 0xff, 0xff, 0xf9, 0xff, 0xff, 
    0xff, 0x07, 0xff, 0xff, 0x91, 0xff, 0xff, 0xc3, 0xff, 0xff, 0xc8, 0xff, 0xff, 0xf0, 0xff, 0xff, 
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    0xff, 0xff, 0xff, 0xff, 0xff, 0xff, 0xff, 0xff, 0xff, 0xff, 0xff, 0xff, 0xff, 0xff, 0xff, 0xff
};

// OLED Logo and Image array
static const unsigned char* const imagesEasy[] = { image1_easy, image2_easy, image3_easy };
static const unsigned char* const imagesMedium[] = { image1_medium, image2_medium, image3_medium };
static const unsigned char* const imagesHard[] = { image1_hard, image2_hard, image3_hard };

bool imagesCompletedEasy[sizeof(imagesEasy) / sizeof(imagesEasy[0])] = {false};
bool imagesCompletedMedium[sizeof(imagesMedium) / sizeof(imagesMedium[0])] = {false};
bool imagesCompletedHard[sizeof(imagesHard) / sizeof(imagesHard[0])] = {false};
bool* currentCompleted;

// Create pointers to these arrays
static const unsigned char* const outputImagesEasy[] = { outputimage1_easy };
static const unsigned char* const outputImagesMedium[] = { outputimage1_medium };
static const unsigned char* const outputImagesHard[] = { outputimage1_hard };

const unsigned char** currentImages;
int numImages;
int currentImageIndex = 0;

const int nextButtonPin = 2;  // Button to navigate and cycle images
const int selectButtonPin = 4;  // Button to select difficulty
const int backButtonPin = 7;
const int outputButtonPin = 8; // Output button pin
int nextButtonState = 0;
int selectButtonState = 0;
int lastBackButtonState = 0;
int lastNextButtonState = LOW;
int lastSelectButtonState = LOW;
int lastOutputButtonState = LOW;
unsigned long lastDebounceTime = 0;
unsigned long debounceDelay = 50;
int completions = 0;
bool showingOutputImage = false; // Tracks if the output image is currently shown
//const int analogPin = A0;  // Pin where the voltage is read
//float voltage = 0.0;

enum State { START, CHOOSE_DIFFICULTY, VIEW_IMAGES, ALL_COMPLETED };
State currentState = START;
int difficulty = 1; // Current difficulty level (1 for Easy, 2 for Mid, 3 for Hard)
int imageIndex = 0; // Index of the current image

void setup() {
  pinMode(nextButtonPin, INPUT);
  pinMode(selectButtonPin, INPUT);
   pinMode(backButtonPin, INPUT);
   pinMode(outputButtonPin, INPUT);
  Serial.begin(9600);
  lcd.init();
  lcd.backlight();
  display.begin(SSD1306_SWITCHCAPVCC, 0x3C);
   currentCompleted = imagesCompletedEasy;
  display.clearDisplay();
  display.drawBitmap(0, 0, logo, 128, 32, 1);
  display.display();
  showInitialMessage();
}

void showInitialMessage() {
  lcd.clear();
  lcd.print("ELECTROTEACH");
  lcd.setCursor(0, 1);
  lcd.print("START LEARNING");
  delay(3000);  // Wait for 3 seconds and then transition
  transitionToDifficultySelection();
}

void transitionToDifficultySelection() {
  currentState = CHOOSE_DIFFICULTY;
  lcd.clear();
  lcd.print("EASY MID HARD");
  lcd.setCursor(0, 1);
  lcd.print("Difficulty: ");
  lcd.print(difficulty);
  lcd.print("   ");

  // Set current images and completed array based on difficulty
  switch (difficulty) {
    case 1: currentImages = imagesEasy; currentCompleted = imagesCompletedEasy; break;
    case 2: currentImages = imagesMedium; currentCompleted = imagesCompletedMedium; break;
    case 3: currentImages = imagesHard; currentCompleted = imagesCompletedHard; break;
  }
  numImages = sizeof(imagesEasy) / sizeof(imagesEasy[0]); // Assuming all arrays are the same size
  currentImageIndex = 0;
}

void loop() {
  int nextReading = digitalRead(nextButtonPin);
  int selectReading = digitalRead(selectButtonPin);
  int backReading = digitalRead(backButtonPin);
  int outputButtonState = digitalRead(outputButtonPin);
  //int sensorValue = analogRead(analogPin);  // Read the analog input
  //voltage = sensorValue * (5.0 / 1023.0);  // Convert to voltage
  //Serial.print("Voltage: ");
  //Serial.println(voltage);  // Print the voltage to the Serial Monitor
 // delay(1000);  // Delay a second between readings

  if (millis() - lastDebounceTime > debounceDelay) {
    if (nextReading != lastNextButtonState) {
      lastNextButtonState = nextReading;
      if (nextReading == HIGH) {
        handleNextButtonPress();
      }
    }
    if (selectReading != lastSelectButtonState) {
      lastSelectButtonState = selectReading;
      if (selectReading == HIGH) {
        handleSelectButtonPress();
      }
    }
    if (backReading != lastBackButtonState) {
      lastBackButtonState = backReading;
      if (backReading == HIGH) {
        handleBackButtonPress();
      }
    }
    if (outputButtonState != lastOutputButtonState) {
    lastOutputButtonState = outputButtonState;
    if (outputButtonState == HIGH) {
      handleOutputButtonPress();
    }
    }
    lastDebounceTime = millis();
  }
}

void showCompletionCount() {
  int completedCount = 0;
  for (int i = 0; i < numImages; i++) {
    if (currentCompleted[i]) {
      completedCount++;
    }
  }
  lcd.setCursor(0, 1);  // Set cursor to second row
  lcd.print("Completed: ");
  lcd.print(completedCount);
  lcd.print(" of ");
  lcd.print(numImages);
}

void handleBackButtonPress() {
  if (currentState == VIEW_IMAGES || currentState == ALL_COMPLETED) {
    currentState = CHOOSE_DIFFICULTY;
    currentImageIndex = 0; // Reset image index
    transitionToDifficultySelection();
  }
}

void handleNextButtonPress() {
  if (currentState == CHOOSE_DIFFICULTY) {
    difficulty = (difficulty % 3) + 1; // Cycle through 1, 2, 3
    lcd.setCursor(0, 1);
    lcd.print("Difficulty: ");
    lcd.print(difficulty);
    lcd.print("   ");
    switch (difficulty) {
      case 1: currentImages = imagesEasy; numImages = sizeof(imagesEasy) / sizeof(imagesEasy[0]); break;
      case 2: currentImages = imagesMedium; numImages = sizeof(imagesMedium) / sizeof(imagesMedium[0]); break;
      case 3: currentImages = imagesHard; numImages = sizeof(imagesHard) / sizeof(imagesHard[0]); break;
    }
  } else if (currentState == VIEW_IMAGES) {
    do {
      currentImageIndex = (currentImageIndex + 1) % numImages;
    } while (currentCompleted[currentImageIndex] && numImages > 1); // Skip completed images, ensure there's more than one image

    display.clearDisplay();
    display.drawBitmap(0, 0, currentImages[currentImageIndex], 128, 32, 1);
    display.display();
  }
}

void handleSelectButtonPress() {
  if (currentState == CHOOSE_DIFFICULTY) {
    // Transition to viewing images of the selected difficulty
    currentState = VIEW_IMAGES;
    lcd.clear();
    lcd.print("Viewing: ");
    switch (difficulty) {
      case 1:
        lcd.print("Easy");
        currentImages = imagesEasy;
        currentCompleted = imagesCompletedEasy;
        break;
      case 2:
        lcd.print("Medium");
        currentImages = imagesMedium;
        currentCompleted = imagesCompletedMedium;
        break;
      case 3:
        lcd.print("Hard");
        currentImages = imagesHard;
        currentCompleted = imagesCompletedHard;
        break;
    }
    numImages = sizeof(imagesEasy) / sizeof(imagesEasy[0]);
    currentImageIndex = 0; // Start from the first image
    showCompletionCount();  // Show completed count after selecting difficulty
    display.clearDisplay();
    display.drawBitmap(0, 0, currentImages[currentImageIndex], 128, 32, 1);
    display.display();
  } else if (currentState == VIEW_IMAGES) {
    // Mark the current image as completed and move to the next available image
    currentCompleted[currentImageIndex] = true; // Mark the current image as completed
    showCompletionCount();  // Update completion count on the LCD

    // Attempt to find the next uncompleted image
    int originalIndex = currentImageIndex;
    do {
      currentImageIndex = (currentImageIndex + 1) % numImages;
    } while (currentCompleted[currentImageIndex] && currentImageIndex != originalIndex); // Prevent infinite loop

    // Check if all images are completed
    if (currentImageIndex == originalIndex && currentCompleted[currentImageIndex]) {
      currentState = ALL_COMPLETED;
      lcd.clear();
      lcd.print("All Completed!");
      display.clearDisplay();
      display.drawBitmap(0, 0, logo, 128, 32, 1); // Show completion screen
      display.display();
    } else {
      // Display the next uncompleted image
      display.clearDisplay();
      display.drawBitmap(0, 0, currentImages[currentImageIndex], 128, 32, 1);
      display.display();
    }
  }
}

void handleOutputButtonPress() {
  showingOutputImage = !showingOutputImage; // Toggle the state

  if (showingOutputImage) {
    // Display the corresponding output image
    const unsigned char* imageToShow = nullptr;
    switch (difficulty) {
      case 1: imageToShow = outputImagesEasy[currentImageIndex]; break;
      case 2: imageToShow = outputImagesMedium[currentImageIndex]; break;
      case 3: imageToShow = outputImagesHard[currentImageIndex]; break;
    }
    display.clearDisplay();
    display.drawBitmap(0, 0, imageToShow, 128, 32, 1);
    display.display();
  } else {
    // Display the original image
    const unsigned char* imageToShow = currentImages[currentImageIndex];
    display.clearDisplay();
    display.drawBitmap(0, 0, imageToShow, 128, 32, 1);
    display.display();
  }
}
